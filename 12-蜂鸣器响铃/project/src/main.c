// #include "Com_util.h"
// #include <STC89C5xRC.H>
// // 新版开发板P25引脚
// #define BEEP P25

// void main()
// {
//     while (1)
//     {

//         BEEP = ~BEEP;
//         Delayms(1);
//     }
// }

#include <STC89C5xRC.H>

#define BEEP P25

// ================= 音符频率(Hz) =================
#define L1 262
#define L2 294
#define L3 330
#define L4 349
#define L5 392
#define L6 440
#define L7 494
#define M1 523
#define M2 587
#define M3 659
#define M4 698
#define M5 784
#define M6 880
#define M7 988
#define H1 1047
#define H2 1175
#define H3 1319
#define H4 1397
#define H5 1568
#define H6 1760
#define H7 1976
#define REST 0

typedef struct
{
    unsigned int freq; // 频率，0=休止
    unsigned int beat; // 节拍，单位 10ms
} Note;

// ================= 小星星 =================
Note code music[] = {
    {M1, 40}, {M1, 40}, {M5, 40}, {M5, 40}, {M6, 40}, {M6, 40}, {M5, 80}, {M4, 40}, {M4, 40}, {M3, 40}, {M3, 40}, {M2, 40}, {M2, 40}, {M1, 80}, {M5, 40}, {M5, 40}, {M4, 40}, {M4, 40}, {M3, 40}, {M3, 40}, {M2, 80}, {M5, 40}, {M5, 40}, {M4, 40}, {M4, 40}, {M3, 40}, {M3, 40}, {M2, 80}, {M1, 40}, {M1, 40}, {M5, 40}, {M5, 40}, {M6, 40}, {M6, 40}, {M5, 80}, {M4, 40}, {M4, 40}, {M3, 40}, {M3, 40}, {M2, 40}, {M2, 40}, {M1, 80}, {REST, 80}};

#define MUSIC_LEN (sizeof(music) / sizeof(music[0]))

// Note code music[] = {
//     // “都是勇敢的”
//     {L5, 20},
//     {L5, 20},
//     {M1, 20},
//     {M2, 40},
//     {M1, 20},
//     {L5, 40},
//     // “你额头的伤口你的不同你犯的错”
//     {M1, 20},
//     {M2, 20},
//     {M1, 20},
//     {L6, 40},
//     {M2, 20},
//     {M1, 20},
//     {L5, 20},
//     {M1, 20},
//     {M2, 20},
//     {M1, 20},
//     {L6, 40},
//     // “都不必隐藏”
//     {L6, 20},
//     {M1, 20},
//     {M2, 20},
//     {M1, 40},
//     {L5, 40},
//     // “你破旧的玩偶你的面具你的自我”
//     {M1, 20},
//     {M2, 20},
//     {M1, 20},
//     {L6, 40},
//     {M2, 20},
//     {M1, 20},
//     {L5, 20},
//     {M1, 20},
//     {M2, 20},
//     {M1, 20},
//     {L6, 40},
//     {L6, 40},

//     // “爱你孤身走暗巷”
//     {M5, 20},
//     {M5, 20},
//     {M6, 20},
//     {M5, 40},
//     {M3, 40},
//     // “爱你不跪的模样”
//     {M5, 20},
//     {M5, 20},
//     {M6, 20},
//     {M5, 40},
//     {M2, 40},
//     // “爱你对峙过绝望”
//     {M5, 20},
//     {M5, 20},
//     {M6, 20},
//     {M5, 40},
//     {M3, 20},
//     {M2, 40},
//     // “不肯哭一场”
//     {M2, 20},
//     {M1, 20},
//     {L6, 40},
//     {M1, 40},

//     // “去吗 配吗 这褴褛的披风”
//     {M3, 20},
//     {M3, 20},
//     {M2, 20},
//     {M1, 40},
//     {L6, 20},
//     {M1, 40},
//     // “战吗 战啊 以最卑微的梦”
//     {M3, 20},
//     {M3, 20},
//     {M2, 20},
//     {M1, 40},
//     {L6, 20},
//     {M1, 20},
//     {M2, 40},
//     // “致那黑夜中的呜咽与怒吼”
//     {M3, 20},
//     {M5, 20},
//     {M5, 20},
//     {M3, 40},
//     {M2, 20},
//     {M1, 20},
//     {M2, 40},
//     // “谁说站在光里的才算英雄”
//     {M1, 20},
//     {L6, 20},
//     {L5, 20},
//     {L6, 40},
//     {M1, 20},
//     {M2, 40},
//     {M1, 40},

//     // 结尾休止，给一点留白
//     {REST, 80}};
// Note code music[] = {
//     // "E E 休止 E 休止 C E 休止"
//     {H3, 15},
//     {H3, 15},
//     {REST, 15},
//     {H3, 15},
//     {REST, 15},
//     {M1, 15},
//     {H3, 30},
//     {REST, 15},
//     // "G 休止 休止 休止 C 休止 休止 休止"
//     {H5, 15},
//     {REST, 15},
//     {REST, 15},
//     {REST, 15},
//     {M1, 15},
//     {REST, 15},
//     {REST, 15},
//     {REST, 15},
//     // 下一句
//     {L5, 15},
//     {REST, 15},
//     {REST, 15},
//     {REST, 15},
//     {M3, 15},
//     {REST, 15},
//     {REST, 15},
//     {REST, 15},
//     {L6, 15},
//     {REST, 15},
//     {M7, 15},
//     {REST, 15},
//     {L7, 15},
//     {L6, 15},
//     {REST, 15},
//     {REST, 15},
//     // "G E G A 休止 F G 休止"
//     {L5, 15},
//     {H3, 15},
//     {H5, 15},
//     {H6, 15},
//     {REST, 15},
//     {H4, 15},
//     {H5, 15},
//     {REST, 15},
//     // "E 休止 C D B 休止 休止 休止"
//     {H3, 15},
//     {REST, 15},
//     {M1, 15},
//     {M2, 15},
//     {M7, 30},
//     {REST, 30},
//     // 结尾留白
//     {REST, 80}};

// Note code music[] = {
//     // “从前初识这世间 万般流连”
//     {M1, 20},
//     {M2, 20},
//     {M3, 20},
//     {M1, 40},
//     {M6, 20},
//     {L5, 20},
//     {L6, 40},
//     // “看着天边似在眼前”
//     {M1, 20},
//     {L7, 20},
//     {L6, 20},
//     {L7, 40},
//     {M3, 20},
//     {H1, 20},
//     {H2, 40},
//     {H1, 20},
//     {L6, 40},
//     // “也甘愿赴汤蹈火去走它一遍”
//     {L5, 20},
//     {L6, 20},
//     {L5, 20},
//     {L6, 20},
//     {L5, 20},
//     {L6, 20},
//     {L5, 20},
//     {M2, 20},
//     {L5, 20},
//     {M3, 40},

//     // “我曾难自拔于世界之大”
//     {M1, 20},
//     {M2, 20},
//     {M3, 40},
//     {L6, 20},
//     {L5, 20},
//     {L6, 20},
//     {L5, 20},
//     {L6, 20},
//     {M2, 40},
//     // “也沉溺于其中梦话”
//     {M3, 20},
//     {L6, 20},
//     {L5, 20},
//     {L6, 20},
//     {L5, 20},
//     {L6, 20},
//     {M3, 40},
//     // “不得真假 不做挣扎 不惧笑话”
//     {M2, 20},
//     {M1, 20},
//     {L6, 20},
//     {M1, 40},
//     {M2, 20},
//     {M1, 20},
//     {L6, 20},
//     {M1, 40},
//     {M3, 20},
//     {M3, 20},
//     {M4, 20},
//     {M3, 20},
//     {M2, 40},

//     // 结尾留白
//     {REST, 80}};

// #define MUSIC_LEN (sizeof(music) / sizeof(music[0]))

// ================= 全局变量 =================
unsigned int reload;    // 定时器重装值（半周期）
unsigned int beat_left; // 当前音符剩余节拍（单位10ms）
unsigned char note_idx; // 当前播到第几个音符
bit playing = 0;        // 是否正在发声

// 10ms 节拍基准计数（用同一个定时器不好做，这里用软计数）
unsigned int tick_10ms = 0;

// ================= 定时器0初始化 =================
// 模式1(16位)，用于产生音频方波
void Timer0_Init(void)
{
    TMOD &= 0xF0;
    TMOD |= 0x01; // Timer0 模式1
    ET0 = 1;      // 开T0中断
    EA = 1;       // 开总中断
    TR0 = 1;      // 启动T0
    TH0 = 0xFF;
    TL0 = 0xFF;
}

// ================= T0中断：翻转BEEP =================
void Timer0_ISR(void) interrupt 1
{
    if (playing && reload != 0)
    {
        TH0 = (65536 - reload) >> 8;
        TL0 = (65536 - reload) & 0xFF;
        BEEP = ~BEEP;
    }
    else
    {
        // 休止符时停止翻转，重装一个较慢的值避免频繁中断
        TH0 = (65536 - 1000) >> 8;
        TL0 = (65536 - 1000) & 0xFF;
        BEEP = 0;
    }
}

// ================= 简单软件延时（用于节拍） =================
// 11.0592MHz 下约 1ms 一次循环
void Delay_ms(unsigned int ms)
{
    unsigned int i, j;
    for (i = 0; i < ms; i++)
        for (j = 0; j < 110; j++)
            ;
}

// ================= 播一个音符 =================
void PlayNote(unsigned int freq, unsigned int beat)
{
    unsigned int duration_ms = beat * 10; // 节拍转ms

    if (freq == 0)
    {
        // 休止符
        playing = 0;
        BEEP = 0;
        Delay_ms(duration_ms);
    }
    else
    {
        // 半周期计数值 = 半周期时间(us) * 晶振(MHz) / 12
        // 11.0592MHz 下：1us 约 0.9216 个机器周期
        // reload = 500000 / freq * 11.0592 / 12
        unsigned long tmp = 500000UL * 11UL / (freq * 12UL);
        if (tmp == 0)
            tmp = 1;
        if (tmp > 65535UL)
            tmp = 65535UL;
        reload = (unsigned int)tmp;

        playing = 1;
        Delay_ms(duration_ms);
        playing = 0;
        BEEP = 0;
        Delay_ms(5); // 音符间留一点间隔，避免连音
    }
}

// ================= 主函数 =================
void main()
{
    unsigned char i;
    BEEP = 0;
    Timer0_Init();

    while (1)
    {
        for (i = 0; i < MUSIC_LEN; i++)
        {
            PlayNote(music[i].freq, music[i].beat);
        }
        Delay_ms(500); // 播完停一下再循环
    }
}